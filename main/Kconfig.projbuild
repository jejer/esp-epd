## main/Kconfig.projbuild
```kconfig
menu "ESP-EPD Configuration"

config ESP_WIFI_SSID
    string "WiFi SSID"
    default ""
    help
    SSID (network name) to connect to.

config ESP_WIFI_PASSWORD
    string "WiFi Password"
    default ""
    help
    WiFi password (WPA or WPA2) to use.

config PUSHBULLET_TOKEN
    string "PushBullet Access Token"
    default ""
    help
    PushBullet Token to use. https://docs.pushbullet.com/#api-quick-start

endmenu
```
